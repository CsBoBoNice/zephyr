## samples/net/wifi/shell/boards/mimxrt1170_evk_mimxrt1176_cm7_A.conf
```kconfig
CONFIG_EARLY_CONSOLE=y

CONFIG_NETWORKING=y
CONFIG_TEST_RANDOM_GENERATOR=y

CONFIG_MAIN_STACK_SIZE=5200
CONFIG_SHELL_STACK_SIZE=8192
CONFIG_NET_TX_STACK_SIZE=4096
CONFIG_NET_RX_STACK_SIZE=4096

CONFIG_NET_PKT_RX_COUNT=32
CONFIG_NET_PKT_TX_COUNT=32
CONFIG_NET_BUF_RX_COUNT=64
CONFIG_NET_BUF_TX_COUNT=64
CONFIG_NET_MAX_CONTEXTS=16
CONFIG_NET_DHCPV4=y

CONFIG_NET_IPV4=y
CONFIG_NET_IPV6=n

CONFIG_NET_TCP=y

CONFIG_NET_LOG=y
CONFIG_INIT_STACKS=y

CONFIG_NET_SHELL=y

CONFIG_NET_STATISTICS=y
CONFIG_NET_STATISTICS_PERIODIC_OUTPUT=n

CONFIG_WIFI=y
CONFIG_WIFI_LOG_LEVEL_ERR=y
CONFIG_NET_L2_WIFI_SHELL=y
# printing of scan results puts pressure on queues in new locking
# design in net_mgmt. So, use a higher timeout for a crowded
# environment.
CONFIG_NET_MGMT_EVENT_QUEUE_TIMEOUT=5000
CONFIG_NET_MGMT_EVENT_QUEUE_SIZE=32



# nothing here
CONFIG_POSIX_API=y
CONFIG_BUILD_OUTPUT_HEX=y

# 启用基础WiFi支持
CONFIG_WIFI=y

# 启用网络支持
CONFIG_NETWORKING=y

# 启用NXP WiFi驱动
CONFIG_WIFI_NXP=y

# 选择88W8987芯片
CONFIG_NXP_88W8987=y

# 选择MURATA 1ZM M2模块
CONFIG_NXP_88W8987_MURATA_1ZM_M2=y

# SDIO相关配置
CONFIG_SDHC=y
CONFIG_SDIO_STACK=y

# 网络协议栈配置
CONFIG_NET_IPV4=y
CONFIG_NET_IPV6=y

# 网络缓冲配置
CONFIG_NET_BUF=y
CONFIG_NET_BUF_DATA_SIZE=2048

# 系统工作队列配置
CONFIG_SYSTEM_WORKQUEUE_STACK_SIZE=4096

# 调试配置
CONFIG_LOG=y
CONFIG_LOG_MODE_IMMEDIATE=y
# CONFIG_WIFI_LOG_LEVEL_DBG=y
# CONFIG_NET_LOG=y
# CONFIG_NET_SOCKETS_LOG_LEVEL_DBG=y
# CONFIG_NET_MGMT_EVENT_LOG_LEVEL_DBG=y

# 添加必要的网络配置
CONFIG_NET_L2_ETHERNET=y
CONFIG_NET_L2_ETHERNET_MGMT=y
CONFIG_NET_MGMT=y
CONFIG_NET_MGMT_EVENT=y

# os
CONFIG_THREAD_CUSTOM_DATA=y
CONFIG_EVENTS=y
CONFIG_SYS_HEAP_AUTO=y
CONFIG_HEAP_MEM_POOL_SIZE=262144
CONFIG_SCHED_MULTIQ=y
CONFIG_ZVFS_OPEN_MAX=30

# shell
CONFIG_NXP_WIFI_SHELL=y
CONFIG_SHELL_ARGC_MAX=48
CONFIG_WIFI_SHELL_MAX_AP_STA=8
CONFIG_WIFI_MGMT_AP_MAX_NUM_STA=8
CONFIG_SHELL_CMD_BUFF_SIZE=512

# net
CONFIG_NET_L2_ETHERNET=y
CONFIG_NET_DHCPV4_SERVER_ADDR_COUNT=32
CONFIG_NET_IPV4=y
CONFIG_NET_IPV6=y
CONFIG_ETH_MCUX=n
CONFIG_NET_ZPERF=y
CONFIG_NET_ZPERF_MAX_PACKET_SIZE=1500
CONFIG_NET_BUF_LOG=y
# CONFIG_NET_PKT_RX_COUNT=60
# CONFIG_NET_PKT_TX_COUNT=40
# CONFIG_NET_BUF_RX_COUNT=60
# CONFIG_NET_BUF_TX_COUNT=80
# CONFIG_NET_BUF_DATA_SIZE=1744
CONFIG_NET_TC_TX_COUNT=1
CONFIG_NET_TC_RX_COUNT=1
CONFIG_NET_MGMT_EVENT_QUEUE_SIZE=20
CONFIG_NET_IF_MAX_IPV4_COUNT=4
CONFIG_NET_IF_MAX_IPV6_COUNT=4
CONFIG_DNS_RESOLVER=y
CONFIG_DNS_RESOLVER_MAX_SERVERS=2
CONFIG_NET_SOCKETS_POLL_MAX=14
CONFIG_NET_ZPERF_MAX_SESSIONS=6
CONFIG_NET_IPV4_FRAGMENT=y
CONFIG_NET_IPV4_FRAGMENT_MAX_COUNT=3
CONFIG_NET_IPV4_FRAGMENT_MAX_PKT=7
CONFIG_NET_IPV4_FRAGMENT_TIMEOUT=3
CONFIG_NET_IPV6_FRAGMENT=y
CONFIG_NET_IPV6_FRAGMENT_MAX_COUNT=3
CONFIG_NET_IPV6_FRAGMENT_MAX_PKT=8
CONFIG_NET_IPV6_FRAGMENT_TIMEOUT=3
CONFIG_NET_MAX_CONN=10
CONFIG_NET_DHCPV4_SERVER_ICMP_PROBE_TIMEOUT=100

# net threads priority
CONFIG_NET_TC_THREAD_PRIO_CUSTOM=y
CONFIG_NET_TC_THREAD_PREEMPTIVE=y
CONFIG_NET_TCP_WORKER_PRIO=-16
CONFIG_NET_TC_TX_THREAD_BASE_PRIO=3
CONFIG_NET_TC_RX_THREAD_BASE_PRIO=3
CONFIG_ZPERF_WORK_Q_THREAD_PRIORITY=3
CONFIG_NET_SOCKETS_SERVICE_THREAD_PRIO=3
CONFIG_NET_TC_SKIP_FOR_HIGH_PRIO=y
CONFIG_NET_CONTEXT_PRIORITY=y
CONFIG_NET_MGMT_THREAD_PRIO_CUSTOM=y
CONFIG_NET_MGMT_THREAD_PRIORITY=3

# 添加DHCP配置
CONFIG_NET_DHCPV4=y
CONFIG_NET_DHCPV4_INITIAL_DELAY_MAX=10

# 添加TCP配置
CONFIG_NET_TCP=y
CONFIG_NET_TCP_WORKER_PRIO=-16

# 添加Shell配置
CONFIG_SHELL=y
CONFIG_SHELL_BACKEND_SERIAL=y
CONFIG_SHELL_CMD_BUFF_SIZE=512
CONFIG_SHELL_ARGC_MAX=48


CONFIG_NET_STATISTICS_WIFI=y
CONFIG_NET_STATISTICS_USER_API=y

# WiFi任务栈大小配置
CONFIG_NXP_WIFI_MON_STACK_SIZE=2048
CONFIG_NXP_WIFI_WLCMGR_STACK_SIZE=8192
CONFIG_NXP_WIFI_POWERSAVE_STACK_SIZE=1024
CONFIG_NXP_WIFI_TX_STACK_SIZE=4096
CONFIG_NXP_WIFI_DRIVER_STACK_SIZE=4096
CONFIG_NXP_WIFI_SCAN_STACK_SIZE=4096

# 其他内存相关配置
CONFIG_SYSTEM_WORKQUEUE_STACK_SIZE=4096
CONFIG_NET_MGMT_EVENT_STACK_SIZE=4096
CONFIG_NET_SOCKETS_SERVICE_STACK_SIZE=4096


# 禁用WMM功能
CONFIG_NXP_WIFI_WMM=n
CONFIG_NXP_WIFI_WMM_UAPSD=n

# 禁用依赖WMM的其他功能
CONFIG_NXP_WIFI_SDIO_MULTI_PORT_TX_AGGR=n
CONFIG_NXP_WIFI_TURBO_MODE=n

# 禁用11AX和11AC (因为它们依赖WMM)
CONFIG_NXP_WIFI_11AX=n 
CONFIG_NXP_WIFI_11AC=n
```
